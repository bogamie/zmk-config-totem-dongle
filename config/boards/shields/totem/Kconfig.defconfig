## config/boards/shields/totem/Kconfig.defconfig
```kconfig
# Copyright (c) 2022 The ZMK Contributors
# SPDX-License-Identifier: MIT

if SHIELD_TOTEM_DONGLE

config ZMK_KEYBOARD_NAME
    default "TOTEM"

config ZMK_SPLIT_ROLE_CENTRAL
    default y

config ZMK_USB
    default y

config TOTEM_BATTERY_HID_REPORT
    bool "Expose left/right peripheral battery levels via a custom USB HID report"
    default y
    depends on ZMK_USB && ZMK_SPLIT_BLE_CENTRAL_BATTERY_LEVEL_FETCHING
    select USB_HID_DEVICE_CLASS
    help
      Adds a second USB HID interface to the dongle that publishes a
      vendor-defined input report (Report ID 1, 2 bytes) carrying the
      state-of-charge of the left and right split halves. Used by the
      zmk-totem-battery-tray daemon on Linux to render battery
      percentages in the system tray. Requires CONFIG_USB_HID_DEVICE_COUNT
      to be at least 2 (set in totem_dongle.conf).

endif

if ZMK_DISPLAY

config I2C
    default y

config SSD1306
    default y

choice ZMK_DISPLAY_WORK_QUEUE
    default ZMK_DISPLAY_WORK_QUEUE_DEDICATED
endchoice

endif

if LVGL

config LV_Z_VDB_SIZE
    default 64

config LV_DPI_DEF
    default 148

config LV_Z_BITS_PER_PIXEL
    default 1

choice LV_COLOR_DEPTH
    default LV_COLOR_DEPTH_1
endchoice

endif

if SHIELD_TOTEM_LEFT || SHIELD_TOTEM_RIGHT || SHIELD_TOTEM_DONGLE

config ZMK_SPLIT
    default y

config ZMK_BLE
    default y

endif
```
